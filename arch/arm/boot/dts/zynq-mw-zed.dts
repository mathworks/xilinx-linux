/dts-v1/;

/include/ "zynq-zed.dtsi"
/include/ "zynq-mw-ipcore-zed.dtsi"

/ {
	chosen {
        bootargs = "console=ttyPS0,115200 root=/dev/ram rw earlyprintk";
		linux,stdout-path = "/amba@0/uart@E0001000";
	};
};

